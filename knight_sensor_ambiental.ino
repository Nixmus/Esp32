#include <DHT.h>
#include <Adafruit_GFX.h>
#include <Adafruit_SSD1306.h>
#include <Wire.h>

// Configuración de pines
#define DHTPIN 15         // Pin del DHT11
#define DHTTYPE DHT11     // Tipo de sensor
#define LED_PINS {10, 9, 8, 7} // Array de pines de LEDs
#define PULSADOR_PIN 2    // Pulsador con PULLUP interno
#define LDR_PIN A0        // LDR en A0 con resistencia 10kΩ

#define RGB_RED_PIN 3     // Pin para el rojo (PWM)
#define RGB_GREEN_PIN 5   // Pin para el verde (PWM)
#define RGB_BLUE_PIN 6    // Pin para el azul (PWM)

// Configuración OLED
#define ANCHO_PANTALLA 128
#define ALTO_PANTALLA 64
#define DIRECCION_OLED 0x3C

// Intervalos de tiempo (ms)
#define INTERVALO_DHT 2000    // Lectura cada 2 segundos
#define INTERVALO_LDR 500     // Lectura cada 500ms
#define INTERVALO_SERIAL 3000 // Envío por serial cada 3 segundos
#define TIEMPO_MENSAJE 5000   // Mostrar mensajes por 5 segundos
#define DEBOUNCE_TIME 50      // Tiempo anti-rebote

// Tiempos para imágenes
#define TIEMPO_IMAGEN1 3000   // Primera imagen por 3 segundos (ahora imagen2)
#define TIEMPO_IMAGEN2 2000   // Segunda imagen por 2 segundos (ahora imagen1)

// Tipos de mensaje temporal
enum TipoMensaje {
  MENSAJE_NINGUNO,
  MENSAJE_PULSACIONES,
  MENSAJE_TEMPERATURA,
  MENSAJE_LUZ,
  MENSAJE_IMAGENES,
  MENSAJE_RGB
};

// Arrays de imágenes (128x64 pixels = 1024 bytes)
const unsigned char imagen1[] PROGMEM = {

  0xff, 0xff, 0xff, 0xff, 0xff, 0xff, 0xff, 0xff, 0xff, 0xff, 0xff, 0xff, 0xff, 0xff, 0xff, 0xff, 
	0xff, 0xff, 0xff, 0xff, 0xff, 0xff, 0xff, 0xff, 0xff, 0xff, 0xff, 0xff, 0xff, 0xff, 0xff, 0xff, 
	0xff, 0xff, 0xff, 0xff, 0xff, 0xff, 0xff, 0xff, 0xff, 0xff, 0xff, 0xff, 0xff, 0xff, 0xff, 0xff, 
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	0xff, 0xff, 0xff, 0xff, 0xff, 0xff, 0xff, 0xff, 0xff, 0xff, 0xff, 0xff, 0xff, 0xff, 0xff, 0xff

};

const unsigned char imagen2[] PROGMEM = {
  0xff, 0xff, 0xff, 0xff, 0x00, 0x00, 0x00, 0x00, 0x00, 0x00, 0x00, 0x00, 0xff, 0xff, 0xff, 0xff,
	0xff, 0xff, 0xff, 0xff, 0x00, 0x00, 0x00, 0x04, 0x10, 0x00, 0x00, 0x04, 0xff, 0xff, 0xff, 0xff,
	0xff, 0xff, 0xff, 0xff, 0x12, 0x49, 0x27, 0xfc, 0x6f, 0xff, 0xff, 0xf8, 0xff, 0xff, 0xff, 0xff,
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	0xff, 0xff, 0xff, 0xff, 0x10, 0x80, 0x00, 0x00, 0x10, 0x01, 0x00, 0x12, 0xff, 0xff, 0xff, 0xff,
};

// Estados para mostrar imágenes
enum EstadoImagen {
  IMAGEN_NINGUNA,
  IMAGEN_PRIMERA,   // Mostrar imagen2 primero (3 segundos)
  IMAGEN_SEGUNDA    // Mostrar imagen1 después (2 segundos)
};

Adafruit_SSD1306 display(ANCHO_PANTALLA, ALTO_PANTALLA, &Wire, -1);
DHT dht(DHTPIN, DHTTYPE);

// Variables del sistema
struct {
  int pulsaciones = 0;
  float temperatura = NAN;
  float humedad = NAN;
  float luz = 0;
  bool estadoLEDs[4] = {false};
  unsigned long ultimaLecturaDHT = 0;
  unsigned long ultimaLecturaLDR = 0;
  unsigned long ultimoEnvioSerial = 0;
  bool estadoPulsadorAnterior = HIGH;
  unsigned long ultimoDebounce = 0;
  unsigned long tiempoMensaje = 0;
  TipoMensaje tipoMensaje = MENSAJE_NINGUNO;
  EstadoImagen estadoImagen = IMAGEN_NINGUNA;
  unsigned long tiempoInicioImagen = 0;
  bool cicloImagenActivo = false;
  int redValue = 0;
  int greenValue = 0;
  int blueValue = 0;
} sistema;

const int leds[4] = LED_PINS;

// Prototipos de funciones
void setRGBColor(int r, int g, int b);
void actualizarDisplay(unsigned long ahora);
void manejarSerial();
void toggleLED(int index);
void procesoComandoRGB(String comando);
void mostrarImagen(const unsigned char* imagen);
void iniciarCicloImagenes();
void mostrarPantallaInicial();
void manejarPulsador();
void leerSensores(unsigned long ahora);
void manejarImagenes(unsigned long ahora);
float calcularPorcentajeLuz(int valorLDR);
void enviarDatosSerial(unsigned long ahora);

void setRGBColor(int r, int g, int b) {
  sistema.redValue = constrain(r, 0, 255);
  sistema.greenValue = constrain(g, 0, 255);
  sistema.blueValue = constrain(b, 0, 255);
  
  // Invertir los valores para cátodo común
  analogWrite(RGB_RED_PIN, 255 - sistema.redValue);
  analogWrite(RGB_GREEN_PIN, 255 - sistema.greenValue);
  analogWrite(RGB_BLUE_PIN, 255 - sistema.blueValue);
  
  Serial.print(F("Color RGB actualizado: R="));
  Serial.print(sistema.redValue);
  Serial.print(F(" G="));
  Serial.print(sistema.greenValue);
  Serial.print(F(" B="));
  Serial.println(sistema.blueValue);
}

void setup() {
  for (int i = 0; i < 4; i++) {
    pinMode(leds[i], OUTPUT);
    digitalWrite(leds[i], LOW);
  }
  pinMode(PULSADOR_PIN, INPUT_PULLUP);
  
  pinMode(RGB_RED_PIN, OUTPUT);
  pinMode(RGB_GREEN_PIN, OUTPUT);
  pinMode(RGB_BLUE_PIN, OUTPUT);
  setRGBColor(0, 0, 0);

  Serial.begin(115200);
  while (!Serial);
  Serial.println(F("\nSistema de monitoreo inicializado"));
  Serial.println(F("Listo para recibir comandos (escriba ? para ayuda)"));

  dht.begin();

  if (!display.begin(SSD1306_SWITCHCAPVCC, DIRECCION_OLED)) {
    Serial.println(F("Error al iniciar OLED"));
    while (true);
  }
  
  mostrarPantallaInicial();
  delay(2000);

  analogWrite(RGB_RED_PIN, 255);
  analogWrite(RGB_GREEN_PIN, 255);
  analogWrite(RGB_BLUE_PIN, 255);
}

void loop() {
  unsigned long ahora = millis();

  manejarPulsador();
  leerSensores(ahora);
  manejarImagenes(ahora);
  actualizarDisplay(ahora);
  enviarDatosSerial(ahora);
  manejarSerial();
}

void mostrarPantallaInicial() {
  display.clearDisplay();
  display.setTextSize(1);
  display.setTextColor(SSD1306_WHITE);
  
  display.setCursor(0, 0);
  display.println(F("Sistema de Monitoreo"));
  display.println(F("Modo Simplificado"));
  display.println(F("-------------------"));
  display.println(F("LEDs: 0000"));
  
  display.display();
}

void manejarPulsador() {
  bool estadoActual = digitalRead(PULSADOR_PIN);
  unsigned long ahora = millis();
  
  if (estadoActual != sistema.estadoPulsadorAnterior) {
    sistema.ultimoDebounce = ahora;
  }
  
  if ((ahora - sistema.ultimoDebounce) > DEBOUNCE_TIME) {
    if (estadoActual == LOW && sistema.estadoPulsadorAnterior == HIGH) {
      sistema.pulsaciones++;
      sistema.tipoMensaje = MENSAJE_PULSACIONES;
      sistema.tiempoMensaje = ahora;
      Serial.print(F("Pulsacion detectada. Total: "));
      Serial.println(sistema.pulsaciones);
    }
  }
  
  sistema.estadoPulsadorAnterior = estadoActual;
}

void leerSensores(unsigned long ahora) {
  if (ahora - sistema.ultimaLecturaDHT >= INTERVALO_DHT) {
    sistema.temperatura = dht.readTemperature();
    sistema.humedad = dht.readHumidity();
    
    if (isnan(sistema.temperatura)) {
      Serial.println(F("Error lectura temperatura"));
    }
    sistema.ultimaLecturaDHT = ahora;
  }

  if (ahora - sistema.ultimaLecturaLDR >= INTERVALO_LDR) {
    int valorLDR = analogRead(LDR_PIN);
    sistema.luz = calcularPorcentajeLuz(valorLDR);
    sistema.ultimaLecturaLDR = ahora;
  }
}

void manejarImagenes(unsigned long ahora) {
  if (!sistema.cicloImagenActivo) return;
  
  unsigned long tiempoTranscurrido = ahora - sistema.tiempoInicioImagen;
  
  switch (sistema.estadoImagen) {
    case IMAGEN_PRIMERA:
      // Mostrar imagen2 por 3 segundos
      if (tiempoTranscurrido >= TIEMPO_IMAGEN1) {
        sistema.estadoImagen = IMAGEN_SEGUNDA;
        sistema.tiempoInicioImagen = ahora;
        Serial.println(F("Cambiando a imagen1 (2 segundos)"));
      }
      break;
      
    case IMAGEN_SEGUNDA:
      // Mostrar imagen1 por 2 segundos
      if (tiempoTranscurrido >= TIEMPO_IMAGEN2) {
        sistema.cicloImagenActivo = false;
        sistema.estadoImagen = IMAGEN_NINGUNA;
        sistema.tipoMensaje = MENSAJE_NINGUNO;
        Serial.println(F("Ciclo de imagenes completado"));
      }
      break;
      
    default:
      break;
  }
}

void iniciarCicloImagenes() {
  sistema.cicloImagenActivo = true;
  sistema.estadoImagen = IMAGEN_PRIMERA;
  sistema.tipoMensaje = MENSAJE_IMAGENES;
  sistema.tiempoInicioImagen = millis();
  Serial.println(F("Iniciando ciclo de imagenes"));
  Serial.println(F("Mostrando imagen2 (3 segundos)"));
}

void mostrarImagen(const unsigned char* imagen) {
  display.clearDisplay();
  display.drawBitmap(0, 0, imagen, ANCHO_PANTALLA, ALTO_PANTALLA, SSD1306_WHITE);
  display.display();
}

float calcularPorcentajeLuz(int valorLDR) {
  const float VREF = 5.0;
  const float R_FIJA = 10000.0;
  const float R_MIN = 470.0;
  const float R_MAX = 1000000.0;

  float voltaje = valorLDR * (VREF / 1023.0);
  float rLDR = (voltaje * R_FIJA) / (VREF - voltaje);
  rLDR = constrain(rLDR, R_MIN, R_MAX);
  
  float porcentaje = 100.0 * (1.0 - (log(rLDR) - log(R_MIN)) / (log(R_MAX) - log(R_MIN)));
  return constrain(porcentaje, 0, 100);
}

void enviarDatosSerial(unsigned long ahora) {
  if (ahora - sistema.ultimoEnvioSerial >= INTERVALO_SERIAL) {
    Serial.println(F("\n=== DATOS AUTOMATICOS ==="));
    Serial.print(F("Tiempo: "));
    Serial.print(ahora / 1000);
    Serial.println(F(" seg"));
    
    Serial.print(F("Pulsaciones: "));
    Serial.println(sistema.pulsaciones);
    
    Serial.print(F("Temperatura: "));
    if (isnan(sistema.temperatura)) {
      Serial.println(F("Error"));
    } else {
      Serial.print(sistema.temperatura, 1);
      Serial.println(F(" C"));
    }
    
    Serial.print(F("Humedad: "));
    if (isnan(sistema.humedad)) {
      Serial.println(F("Error"));
    } else {
      Serial.print(sistema.humedad, 1);
      Serial.println(F(" %"));
    }
    
    Serial.print(F("Luz: "));
    Serial.print(sistema.luz, 1);
    Serial.println(F(" %"));
    
    Serial.print(F("LEDs: "));
    for (int i = 0; i < 4; i++) {
      Serial.print(sistema.estadoLEDs[i] ? "1" : "0");
    }
    Serial.println();
    Serial.println(F("========================"));
    
    sistema.ultimoEnvioSerial = ahora;
  }
}

void procesoComandoRGB(String comando) {
  int r = sistema.redValue;
  int g = sistema.greenValue;
  int b = sistema.blueValue;
  
  comando.toUpperCase();
  comando.replace(" ", "");
  
  int startIdx = 0;
  while (startIdx < comando.length()) {
    int endIdx = comando.indexOf(',', startIdx);
    if (endIdx == -1) endIdx = comando.length();
    
    String component = comando.substring(startIdx, endIdx);
    
    if (component.startsWith("R=")) {
      r = component.substring(2).toInt();
    } else if (component.startsWith("G=")) {
      g = component.substring(2).toInt();
    } else if (component.startsWith("B=")) {
      b = component.substring(2).toInt();
    }
    
    startIdx = endIdx + 1;
  }
  
  setRGBColor(r, g, b);
  sistema.tipoMensaje = MENSAJE_RGB;
  sistema.tiempoMensaje = millis();
}

void actualizarDisplay(unsigned long ahora) {
  if (sistema.cicloImagenActivo) {
    switch (sistema.estadoImagen) {
      case IMAGEN_PRIMERA:
        mostrarImagen(imagen2); // Mostrar imagen2 primero (3 segundos)
        return;
      case IMAGEN_SEGUNDA:
        mostrarImagen(imagen1); // Mostrar imagen1 después (2 segundos)
        return;
      default:
        break;
    }
  }
  
  display.clearDisplay();
  display.setTextColor(SSD1306_WHITE);
  
  if (sistema.tipoMensaje != MENSAJE_NINGUNO && 
      (ahora - sistema.tiempoMensaje < TIEMPO_MENSAJE)) {
    
    switch (sistema.tipoMensaje) {

        case MENSAJE_RGB:
        display.setTextSize(1);
        display.setCursor(0, 5);
        display.println(F("Color RGB Actual:"));
        
        display.setTextSize(2);
        display.setCursor(0, 20);
        display.print(F("R: "));
        display.println(sistema.redValue);
        
        display.setCursor(0, 40);
        display.print(F("G: "));
        display.println(sistema.greenValue);
        
        display.setCursor(70, 20);
        display.print(F("B: "));
        display.println(sistema.blueValue);
        
        // Pequeña representación del color
        display.fillRect(70, 40, 20, 20, SSD1306_WHITE);
        break;

      case MENSAJE_PULSACIONES:
        display.setTextSize(2);
        display.setCursor(0, 10);
        display.println(F("Pulsaciones:"));
        
        display.setTextSize(3);
        display.setCursor(40, 35);
        display.println(sistema.pulsaciones);
        break;
        
      case MENSAJE_TEMPERATURA:
        display.setTextSize(2);
        display.setCursor(0, 5);
        display.println(F("Temperatura"));
        
        display.setTextSize(1);
        display.setCursor(0, 30);
        display.print(F("Temp: "));
        if (isnan(sistema.temperatura)) {
          display.println(F("-- C"));
        } else {
          display.print(sistema.temperatura, 1);
          display.println(F(" C"));
        }
        
        display.setCursor(0, 45);
        display.print(F("Humedad: "));
        if (isnan(sistema.humedad)) {
          display.println(F("-- %"));
        } else {
          display.print(sistema.humedad, 1);
          display.println(F(" %"));
        }
        break;
        
      case MENSAJE_LUZ:
        display.setTextSize(2);
        display.setCursor(0, 10);
        display.println(F("Nivel Luz"));
        
        display.setTextSize(3);
        display.setCursor(20, 35);
        display.print(sistema.luz, 1);
        display.println(F("%"));
        break;
    }
  } 
  else {
    if (sistema.tipoMensaje != MENSAJE_NINGUNO && sistema.tipoMensaje != MENSAJE_IMAGENES) {
      sistema.tipoMensaje = MENSAJE_NINGUNO;
    }
    
    display.setTextSize(1);
    display.setCursor(0, 15);
    display.println(F("Estado LEDs:"));
    
    display.setTextSize(2);
    display.setCursor(20, 35);
    for (int i = 0; i < 4; i++) {
      display.print(sistema.estadoLEDs[i] ? "1" : "0");
      if (i < 3) display.print(" ");
    }
  }
  
  display.display();
}

void toggleLED(int index) {
  if (index >= 0 && index < 4) {
    sistema.estadoLEDs[index] = !sistema.estadoLEDs[index];
    digitalWrite(leds[index], sistema.estadoLEDs[index] ? HIGH : LOW);
    
    Serial.print(F("LED "));
    Serial.print(leds[index]);
    Serial.println(sistema.estadoLEDs[index] ? F(" ON") : F(" OFF"));
    
    Serial.print(F("Estado LEDs: "));
    for (int i = 0; i < 4; i++) {
      Serial.print(sistema.estadoLEDs[i] ? "1" : "0");
    }
    Serial.println();
    
    actualizarDisplay(millis());
  }
}

void manejarSerial() {
  if (Serial.available() > 0) {
    String comando = Serial.readStringUntil('\n');
    comando.trim();
    
    if (comando.length() > 0) {
      if (comando.indexOf('R') != -1 || comando.indexOf('G') != -1 || comando.indexOf('B') != -1) {
        procesoComandoRGB(comando);
        return;
      }
      
      char cmd = toupper(comando[0]);
      
      switch (cmd) {
        case '1': case '2': case '3': case '4':
          toggleLED(cmd - '1');
          break;
        case 'T':
          sistema.temperatura = dht.readTemperature();
          sistema.humedad = dht.readHumidity();
          sistema.tipoMensaje = MENSAJE_TEMPERATURA;
          sistema.tiempoMensaje = millis();
          break;
        case 'L':
          sistema.luz = calcularPorcentajeLuz(analogRead(LDR_PIN));
          sistema.tipoMensaje = MENSAJE_LUZ;
          sistema.tiempoMensaje = millis();
          break;
        case 'I':
          iniciarCicloImagenes();
          break;
        case 'S':
          sistema.tipoMensaje = MENSAJE_NINGUNO;
          Serial.println(F("\n--- Estado del Sistema ---"));
          Serial.print(F("Pulsaciones: "));
          Serial.println(sistema.pulsaciones);
          Serial.print(F("Temperatura: "));
          Serial.print(sistema.temperatura, 1);
          Serial.println(F("°C"));
          Serial.print(F("Humedad: "));
          Serial.print(sistema.humedad, 1);
          Serial.println(F("%"));
          Serial.print(F("Luz: "));
          Serial.print(sistema.luz, 1);
          Serial.println(F("%"));
          Serial.print(F("LEDs: "));
          for (int i = 0; i < 4; i++) {
            Serial.print(sistema.estadoLEDs[i] ? "1" : "0");
          }
          Serial.println();
          break;
        case 'W':
          sistema.tipoMensaje = MENSAJE_RGB;
          sistema.tiempoMensaje = millis();
          Serial.print(F("Color RGB actual: R="));
          Serial.print(sistema.redValue);
          Serial.print(F(" G="));
          Serial.print(sistema.greenValue);
          Serial.print(F(" B="));
          Serial.println(sistema.blueValue);
          break;
        default:
          sistema.tipoMensaje = MENSAJE_NINGUNO;
          Serial.println(F("Comando no reconocido"));
          Serial.println(F("Escriba ? para ayuda"));  
      }
    }
  }
}


//case '?':
  //sistema.tipoMensaje = MENSAJE_NINGUNO;
  //Serial.println(F("\n=== MENU DE AYUDA ==="));
  //Serial.println(F("A-D: Alternar LEDs 1-4"));
  //Serial.println(F("R: Resetear contador"));
  //Serial.println(F("T: Leer temperatura"));
  //Serial.println(F("L: Leer nivel de luz"));
  //Serial.println(F("I: Mostrar imagenes"));
  //Serial.println(F("S: Estado del sistema"));
  //Serial.println(F("W: Mostrar color RGB"));
  //Serial.println(F("R=val,G=val,B=val: Cambiar color"));
  //Serial.println(F("?: Mostrar ayuda"));
  //Serial.println(F("===================="));
  //break;
